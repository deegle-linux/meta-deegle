## conf/distro/ddeegle.conf
```bitbake
#Distro to build an specific FXNEVOS version

require conf/distro/deegle.conf

DISTRO = "ddeegle"
DISTRO_NAME = "Deegle Linux Distribution with Debug Tools"


IMAGE_FEATURES:append = " \
    allow-empty-password \
    allow-root-login \
    empty-root-password \
    ssh-server-openssh \
"
```

## conf/distro/deegle.conf
```bitbake
require conf/distro/poky.conf

DISTRO = "deegle"
DISTRO_NAME = "Deegle Linux Distribution"
DISTRO_VERSION = "1.0"

PACKAGE_CLASSES ?= "package_ipk"

INIT_MANAGER = "systemd"

VIRTUAL-RUNTIME_init_manager = "systemd"
PREFERRED_PROVIDER_udev = "systemd"
DISTRO_FEATURES_BACKFILL_CONSIDERED = "sysvinit"

VIRTUAL-RUNTIME_syslog = ""
VIRTUAL-RUNTIME_base-utils-syslog = ""

DISTRO_FEATURES:append = " \
    ipv4 \
    overlayfs \
    systemd \
"

# DEEGLE_USB_ETHERNET
KERNEL_MODULE_AUTOLOAD = " \
    g_ether \
"
```

## conf/layer.conf
```bitbake
# We have a conf and classes directory, add to BBPATH
BBPATH .= ":${LAYERDIR}"

# We have recipes-* directories, add to BBFILES
BBFILES += "${LAYERDIR}/recipes-*/*/*.bb \
            ${LAYERDIR}/recipes-*/*/*.bbappend"

BBFILE_COLLECTIONS += "m-deegle"
BBFILE_PATTERN_m-deegle = "^${LAYERDIR}/"
BBFILE_PRIORITY_m-deegle = "6"

LAYERDEPENDS_m-deegle = "core"
LAYERSERIES_COMPAT_m-deegle = "scarthgap"
```
